## GATA_S3/sdkconfig.defaults
```kconfig
# GATA_S3 - DFRobot FireBeetle 2 ESP32-S3 Configuration
# Dual-core Xtensa LX7 @ 240MHz

# --- CPU ---
CONFIG_ESP32S3_DEFAULT_CPU_FREQ_240=y

# --- Memory ---
CONFIG_ESP_SYSTEM_EVENT_TASK_STACK_SIZE=4096

# --- FreeRTOS ---
CONFIG_FREERTOS_HZ=1000

# --- WiFi (CONFIG_ESP_WIFI_* = correct naming for S3) ---
CONFIG_ESP_WIFI_SOFTAP_SUPPORT=y
CONFIG_ESP_WIFI_STATIC_RX_BUFFER_NUM=16
CONFIG_ESP_WIFI_DYNAMIC_RX_BUFFER_NUM=64
CONFIG_ESP_WIFI_TX_BUFFER_TYPE=1
CONFIG_ESP_WIFI_DYNAMIC_TX_BUFFER_NUM=64
CONFIG_ESP_WIFI_AMPDU_TX_ENABLED=y
CONFIG_ESP_WIFI_AMPDU_RX_ENABLED=y

# --- lwIP: mailbox 64 prevents keyframe burst drops ---
CONFIG_LWIP_UDP_RECVMBOX_SIZE=64
CONFIG_LWIP_TCPIP_RECVMBOX_SIZE=64
CONFIG_LWIP_SO_RCVBUF=y

# --- Disable power save for minimum latency ---
CONFIG_PM_ENABLE=n

# --- Log level ---
CONFIG_LOG_DEFAULT_LEVEL_INFO=y
CONFIG_LOG_DEFAULT_LEVEL=3

# --- Flash ---
CONFIG_ESPTOOLPY_FLASHSIZE_4MB=y
CONFIG_PARTITION_TABLE_SINGLE_APP=y

# --- Compiler ---
CONFIG_COMPILER_OPTIMIZATION_PERF=y
```
